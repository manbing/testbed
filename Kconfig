## Kconfig
```kconfig
# SPDX-License-Identifier: GPL-2.0
#
mainmenu "Testbed/$(ARCH) Compile System Configuration"

comment "Compiler: $(CC_VERSION_TEXT)"

source "arch/Kconfig"

source "programs.kernel/Kconfig"

source "programs.user/Kconfig"
```

## arch/Kconfig
```kconfig
menu "Architecture"

choice
	prompt "Arch"
        default ARCH_X86
        help
            Select the Arch which do you want

config ARCH_X86
	bool "x86"
        help
            Intel Chipset

config ARCH_ARM
	bool "arm"
        help
            ARM Chipset
endchoice

config ARCH
	string
        default "x86" if ARCH_X86
        default "arm" if ARCH_ARM
        help
            Arch string

endmenu
```

## arch/x86/platform/i5-8400/Kconfig
```kconfig
config CPU_I5_8400
	bool "Intel i5 8400"
        help
            Intel i5 8400

config CPU_ID
	string
        default "i5-8400" if CPU_I5_8400
        help
            Product ID
```

## lib/libc/Kconfig
```kconfig
choice
	prompt "C Library"
        default LIB_GLIBC
        help
            Select C library which you want

config LIB_GLIBC
	bool "GNU C Library"
        help
            GNU C Library

endchoice

config LIB_C
	string
        default "glibc" if LIB_GLIBC
        help
            C library  which you use
```

## programs.kernel/core/Kconfig
```kconfig
menu "Kernel Core"

choice
	prompt "Select Core"
        default CORE_LINUX_5_0
        help
            Select the Arch which do you want

config CORE_LINUX_5_0
	bool "Linux-5.0"
        help
            Linux kernel 5.0

endchoice

config KERNEL_CORE
	string
        default "linux-5.0" if CORE_LINUX_5_0
        help
            Kernel core which one do you want

endmenu
```

## programs.user/Kconfig
```kconfig
menu "User Space's Programs"

source "programs.user/gpl/Kconfig"

#source "private/Kconfig"

endmenu
```

## programs.user/gpl/Kconfig
```kconfig
menu "GNU General Public License (GPL)"
config GPL_TCPDUMP
	bool "TCPDUMP"
        default n
        help
            TCPDump open source

config GPL_BUSYBOX
	bool "Busybox"
        default y
        help
            Busybox

endmenu
```
